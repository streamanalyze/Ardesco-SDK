## CMakeLists.txt
```
#
# Copyright (c) Ericsson AB 2020, all rights reserved
#

cmake_minimum_required(VERSION 3.8.2)

# Include Ardesco SDK 
set(AR $ENV{ARDESCO_ROOT})
if(DEFINED AR)
   include($ENV{ARDESCO_ROOT}/ardesco.cmake)
else()
   # Assume we are building from the apps folder in Ardesco tree
   include(${CMAKE_CURRENT_SOURCE_DIR}/../../ardesco.cmake)
endif()

project(%%{projectName})
zephyr_compile_definitions(PROJECT_NAME=${PROJECT_NAME})

if(APP_VERSION)
  zephyr_compile_definitions(APP_VERSION=${APP_VERSION})
endif()

# NORDIC SDK APP START
target_sources(app PRIVATE src/main.c)
# NORDIC SDK APP END

# Add lib LED
add_subdirectory(${ARDESCO_LIB_DIR}/led_lib ${CMAKE_BINARY_DIR}/lib/led_lib)
```

## prj.conf
```kconfig
#
# Copyright (c) Ericsson AB 2020, all rights reserved
#

# This is not strictly needed for this example, but 
# most apps will need heap support.
CONFIG_HEAP_MEM_POOL_SIZE=16384
```

## src/main.c
```c
/*
 * Copyright (c) Ericsson AB 2020, all rights reserved
 */

#include <ardesco.h>
#include <ard_led.h>

//========================================================
// Program Entry Point
//========================================================
void main(void)
{
	int rc;
	printk("\nArdesco greets \"Hello World!\"\n");
	rc = led_init ();
	if (rc != 0)
	{
		printk("Failure calling led_init, rc = %d\n", rc);
	}

	while (1)
	{
		blink_led(LED_RED, 500, LED_OFF, 500, 1);
		blink_led(LED_GREEN, 500, LED_OFF, 500, 1);
		blink_led(LED_BLUE, 500, LED_OFF, 500, 1);
		k_sleep(K_MSEC(2000));
		printk ("Ping\n");
	}
}
```
