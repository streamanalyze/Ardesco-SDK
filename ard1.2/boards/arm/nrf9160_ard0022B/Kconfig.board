## ard1.2/boards/arm/nrf9160_ard0022B/Kconfig.board
```kconfig
# Kconfig - nRF91 PCA20035 board configuration
#
# Copyright (c) 2019 Nordic Semiconductor ASA
# Copyright (c) Ericsson AB 2020, all rights reserved
#
# SPDX-License-Identifier: LicenseRef-BSD-5-Clause-Nordic

if SOC_NRF9160_SICA

config BOARD_NRF9160_ARD0022B
	bool "nRF9160 ARD0022B"
	depends on !TRUSTED_EXECUTION_NONSECURE

config BOARD_NRF9160_ARD0022BNS
	bool "nRF9160 ARD0022B non-secure"
	depends on TRUSTED_EXECUTION_NONSECURE

endif # SOC_NRF9160_SICA
```

## ard1.2/boards/arm/nrf9160_ard0031A/Kconfig.board
```kconfig
# Kconfig - nRF91 PCA20035 board configuration
#
# Copyright (c) 2019 Nordic Semiconductor ASA
# Copyright (c) Ericsson AB 2020, all rights reserved
#
# SPDX-License-Identifier: LicenseRef-BSD-5-Clause-Nordic

if SOC_NRF9160_SICA

config BOARD_NRF9160_ARD0031A
	bool "nRF9160 ARD0031A"
	depends on !TRUSTED_EXECUTION_NONSECURE

config BOARD_NRF9160_ARD0031ANS
	bool "nRF9160 ARD0031A non-secure"
	depends on TRUSTED_EXECUTION_NONSECURE

endif # SOC_NRF9160_SICA
```

## ard1.3/boards/arm/nrf52840_ard0022B/Kconfig.board
```kconfig
# Kconfig - nRF52840 PCA20035 board configuration
#
# Copyright (c) 2019 Nordic Semiconductor ASA
# Copyright (c) Ericsson AB 2020, all rights reserved
#
# SPDX-License-Identifier: LicenseRef-BSD-5-Clause-Nordic

config BOARD_NRF52840_PCA20035
	bool "nRF52840 PCA20035"
	depends on SOC_NRF52840_QIAA
```

## ard1.3/boards/arm/nrf52840_ard0022B/Kconfig.defconfig
```kconfig
# Kconfig - nRF52840 ARD0022B board configuration
#
# Copyright (c) 2019 Nordic Semiconductor ASA
# Copyright (c) Ericsson AB 2020, all rights reserved
#
# SPDX-License-Identifier: LicenseRef-BSD-5-Clause-Nordic

if BOARD_NRF52840_ARD0022B

config BOARD
	default "nrf52840_ard0022B"

if USB

config USB_NRF52840
	def_bool y

config USB_DEVICE_STACK
	def_bool y

endif # USB

endif # BOARD_NRF52840_ARD0022B
```

## ard1.3/boards/arm/nrf52840_ard0022B/nrf52840_ard0022B_defconfig
```kconfig
#
# Copyright (c) Ericsson AB 2020, all rights reserved
#
CONFIG_SOC_SERIES_NRF52X=y
CONFIG_SOC_NRF52840_QIAA=y
CONFIG_BOARD_NRF52840_ARD0022B=y

# Enable MPU
CONFIG_ARM_MPU=y

# enable uart driver
CONFIG_SERIAL=y

# Enable console
CONFIG_CONSOLE=y

# Used by boot52 button handler
CONFIG_REBOOT=y
```

## ard1.3/boards/arm/nrf52840_ard0031A/Kconfig.board
```kconfig
# Kconfig - nRF52840 PCA20035 board configuration
#
# Copyright (c) 2019 Nordic Semiconductor ASA
# Copyright (c) Ericsson AB 2020, all rights reserved
#
# SPDX-License-Identifier: LicenseRef-BSD-5-Clause-Nordic

config BOARD_NRF52840_ARD0031A
	bool "nRF52840 ARD0031A"
	depends on SOC_NRF52840_QIAA
```

## ard1.3/boards/arm/nrf52840_ard0031A/Kconfig.defconfig
```kconfig
# Kconfig - nRF52840 PCA20035 board configuration
#
# Copyright (c) 2019 Nordic Semiconductor ASA
# Copyright (c) Ericsson AB 2020, all rights reserved
#
# SPDX-License-Identifier: LicenseRef-BSD-5-Clause-Nordic

if BOARD_NRF52840_ARD0031A

config BOARD
	default "nrf52840_ard0031A"

if USB

config USB_NRF52840
	def_bool n

config USB_DEVICE_STACK
	def_bool n

endif # USB

endif # BOARD_NRF52840_PCA20035
```

## ard1.3/boards/arm/nrf9160_ard0011A/Kconfig.board
```kconfig
# Kconfig - nRF91 PCA20035 board configuration
#
# Copyright (c) 2019 Nordic Semiconductor ASA
# Copyright (c) Ericsson AB 2020, all rights reserved
#
# SPDX-License-Identifier: LicenseRef-BSD-5-Clause-Nordic

if SOC_NRF9160_SICA

config BOARD_NRF9160_ARD0011A
	bool "nRF9160 ARD0011A"
	depends on !TRUSTED_EXECUTION_NONSECURE

config BOARD_NRF9160_ARD0011ANS
	bool "nRF9160 ARD0011A non-secure"
	depends on TRUSTED_EXECUTION_NONSECURE

endif # SOC_NRF9160_SICA
```

## ard1.4/boards/arm/nrf52840_ard0011A/Kconfig.board
```kconfig
# Kconfig - nRF52840 Ardesco Prototype board configuration
#
# Copyright (c) 2019 Nordic Semiconductor ASA
# Copyright (c) Ericsson AB 2020, all rights reserved
#
# SPDX-License-Identifier: LicenseRef-BSD-5-Clause-Nordic

config BOARD_NRF52840_ARD0011A
	bool "nRF52840 ARD0011A"
	depends on SOC_NRF52840_QIAA
```

## ard1.4/boards/arm/nrf52840_ard0021B/Kconfig.board
```kconfig
# Kconfig - nRF52840 Ardesco Combi board configuration
#
# Copyright (c) 2019 Nordic Semiconductor ASA
# Copyright (c) Ericsson AB 2020, all rights reserved
#
# SPDX-License-Identifier: LicenseRef-BSD-5-Clause-Nordic

config BOARD_NRF52840_ARD0021B
	bool "nRF52840 ARD0021B"
	depends on SOC_NRF52840_QIAA
```

## ard1.4/boards/arm/nrf52840_ard0021B/Kconfig.defconfig
```kconfig
# Kconfig - nRF52840 Ardesco Combi board configuration
#
# Copyright (c) 2019 Nordic Semiconductor ASA
# Copyright (c) Ericsson AB 2020, all rights reserved
#
# SPDX-License-Identifier: LicenseRef-BSD-5-Clause-Nordic

if BOARD_NRF52840_ARD0021B

config BOARD
	default "nrf52840_ard0021B"

config REBOOT_BUTTON
	prompt "Enable 52 boot button"
	select REBOOT
	bool
	default y

if USB

config USB_NRF52840
	def_bool y
	
config USB_DEVICE_STACK
	def_bool y

endif # USB

endif # BOARD_NRF52840_ARD0021B
```

## ard1.4/boards/arm/nrf52840_ard0022B/Kconfig.board
```kconfig
# Kconfig - nRF52840 Combi Dev board configuration
#
# Copyright (c) 2019 Nordic Semiconductor ASA
# Copyright (c) Ericsson AB 2020, all rights reserved
#
# SPDX-License-Identifier: LicenseRef-BSD-5-Clause-Nordic

config BOARD_NRF52840_ARD0022B
	bool "nRF52840 ARD0022B"
	depends on SOC_NRF52840_QIAA
```

## ard1.4/boards/arm/nrf9160_ard0022B/nrf9160_ard0022Bns_defconfig
```kconfig
#
# Copyright (c) Ericsson AB 2020, all rights reserved
#
CONFIG_SOC_SERIES_NRF91X=y
CONFIG_SOC_NRF9160_SICA=y
CONFIG_BOARD_NRF9160_ARD0022BNS=y

# Enable MPU
CONFIG_ARM_MPU=y

# Enable TrustZone-M
CONFIG_ARM_TRUSTZONE_M=y

# This Board implies building Non-Secure firmware
CONFIG_TRUSTED_EXECUTION_NONSECURE=y

# Enable GPIO
CONFIG_GPIO=y

# Enable UARTE
CONFIG_SERIAL=y

# Enable console
CONFIG_CONSOLE=y
CONFIG_UART_CONSOLE=y

# Enable I2C
CONFIG_I2C=y
CONFIG_I2C_2=y

# Enable SPI
CONFIG_SPI=y
CONFIG_SPI_3=y

# Enable power management IC ADP536x
CONFIG_ADP536X=n

# Disable entropy driver, as it's not yet implemented for nRF9160
CONFIG_ENTROPY_NRF5_RNG=n

# Select default sensors here. These can be
# overridden in the prj file for an individual application.
CONFIG_SENSOR=y
CONFIG_BME680=y

CONFIG_ADXL362=y
CONFIG_ADXL362_TRIGGER_GLOBAL_THREAD=y
CONFIG_ADXL362_INTERRUPT_MODE=1
CONFIG_ADXL362_ABS_REF_MODE=1

CONFIG_ADXL372=y
CONFIG_ADXL372_TRIGGER_GLOBAL_THREAD=y
CONFIG_ADXL372_SPI=y
CONFIG_ADXL372_MEASUREMENT_MODE=y

CONFIG_BH1749=y
```

## drivers/Kconfig
```kconfig
#
# Copyright (c) 2018-2019 Nordic Semiconductor ASA
# Copyright (c) Ericsson AB 2020, all rights reserved
#
# SPDX-License-Identifier: LicenseRef-BSD-5-Clause-Nordic
#

#
# Modified by Ericsson AB for Ardesco:
# - Based on nRF drivers
# - Changed to support Ardesco drivers
#

menu "Device Drivers"

rsource "adp5360/Kconfig"
rsource "lp_uart/Kconfig"

endmenu
```

## drivers/adp5360/Kconfig
```kconfig
# Kconfig - ADP536x
#
# Copyright (c) 2019 Nordic Semiconductor
# Copyright (c) Ericsson AB 2020, all rights reserved
#
# SPDX-License-Identifier: LicenseRef-BSD-5-Clause-Nordic
#

#
# Modified by Ericsson AB for Ardesco:
# - Based on nRF driver adp536x
# - Changed to support Ardesco battery monitoring
#

menuconfig ADP5360
	bool "ADP5360"
	help
	  Enable ADP5360.

if ADP5360

config ADP536X_BUS_NAME
	string "I2C bus name"
	default "I2C_2"

endif # ADP5360
```

## lib/persist_data/Kconfig
```kconfig
#
# Copyright (c) Ericsson AB 2020, all rights reserved
#

config USB_PERSIST_DATA_LIB
	bool "Persist data library"
	help
	  A simple library to store name-data pairs in flash
```
