## CMakeLists.txt
```
#
# Copyright (c) Ericsson AB 2020, all rights reserved
#

cmake_minimum_required(VERSION 3.8.2)

set(APP_VERSION "1.23")

# Include Ardesco SDK 
set(AR $ENV{ARDESCO_ROOT})
if(DEFINED AR)
   include($ENV{ARDESCO_ROOT}/ardesco.cmake)
else()
   # Assume we are building from the apps folder in Ardesco tree
   include(${CMAKE_CURRENT_SOURCE_DIR}/../../ardesco.cmake)
endif()

project(91ipc_simple)
zephyr_compile_definitions(PROJECT_NAME=${PROJECT_NAME})

# NORDIC SDK APP START
target_sources(app PRIVATE src/main.c)
# NORDIC SDK APP END

# Add lib for 91-52 communication 
add_subdirectory(${ARDESCO_LIB_DIR}/ipclib ${CMAKE_BINARY_DIR}/lib/ipclib)
```

## prj.conf
```kconfig
#
# Copyright (c) Ericsson AB 2020, all rights reserved
#

# This is not strictly needed for this example, but 
# most apps will need heap support.
CONFIG_HEAP_MEM_POOL_SIZE=16384

 # UART
CONFIG_SERIAL=y
CONFIG_UART_INTERRUPT_DRIVEN=y
```

## prj_v12.conf
```kconfig
#
# Copyright (c) Ericsson AB 2020, all rights reserved
#

# This is not strictly needed for this example, but 
# most apps will need heap support.
CONFIG_HEAP_MEM_POOL_SIZE=16384

 # UART
CONFIG_SERIAL=y
CONFIG_UART_INTERRUPT_DRIVEN=y

CONFIG_UART_1_NRF_UARTE=y
```

## nrf9160_ard0021Bns.overlay
```dts
/ {
	chosen {
		zephyr,console = &uart1;
		zephyr,shell-uart = &uart1;
		zephyr,uart-mcumgr = &uart1;
	};
};

&uart1 {
	current-speed = <115200>;
	status = "okay";
	tx-pin = <13>;
	rx-pin = <14>;
};
```

## nrf9160_ard0022Bns.overlay
```dts
/ {
	chosen {
		zephyr,console = &uart0;
		zephyr,shell-uart = &uart0;
		zephyr,uart-mcumgr = &uart0;
	};
};
/* MCU 4 and 5   */
&uart1 {
	current-speed = <115200>;
	status = "okay";
	tx-pin = <22>;
	rx-pin = <23>;
};
```

## src/main.c
```c
/*
 * Copyright (c) Ericsson AB 2020, all rights reserved
 */

#include <ardesco.h>
#include <ipc_communication.h>

//========================================================
// Program Entry Point
//========================================================
void main(void)
{
	char buf[64];
	printk("91ipc_simple started.\n");

	// Initialize the IPC library
	ipc_init ();

	// Loop
	while (1)
	{
		k_sleep(K_MSEC(5000));
		printk ("Ping91\n");

		ipc_get_coproc_ver(buf, _COUNTOF(buf));
		printk ("52840 firmware version: %s\n", buf);
	}
}
```
