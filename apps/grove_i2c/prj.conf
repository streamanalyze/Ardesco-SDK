## CMakeLists.txt
```
#
# Copyright (c) Ericsson AB 2020, all rights reserved
#

cmake_minimum_required(VERSION 3.8.2)

# Include Ardesco SDK 
set(AR $ENV{ARDESCO_ROOT})
if(DEFINED AR)
   include($ENV{ARDESCO_ROOT}/ardesco.cmake)
else()
   # Assume we are building from the apps folder in Ardesco tree
   include(${CMAKE_CURRENT_SOURCE_DIR}/../../ardesco.cmake)
endif()

project(grove_i2c)
zephyr_compile_definitions(PROJECT_NAME=${PROJECT_NAME})

if(APP_VERSION)
  zephyr_compile_definitions(APP_VERSION=${APP_VERSION})
endif()

# NORDIC SDK APP START
target_sources(app PRIVATE src/main.c)
# NORDIC SDK APP END

# Add i2c temp sensor
add_subdirectory(${CMAKE_CURRENT_SOURCE_DIR}/drivers/sht35 ${CMAKE_BINARY_DIR}/drivers/sht35)
```

## prj.conf
```kconfig
#
# Copyright (c) Ericsson AB 2020, all rights reserved
#

# This is not strictly needed for this example, but 
# most apps will need heap support.
CONFIG_HEAP_MEM_POOL_SIZE=16384

#(db) Use for I2C test 
CONFIG_I2C_1=y
CONFIG_I2C_2=y

CONFIG_LOG=y
CONFIG_LOG_IMMEDIATE=n
```

## nrf9160_ard0022Bns.overlay
```dts
/* Using Grove connector as i2c  
 * The Grove Analog / Digital select line is configured
 * in board_nonsecure.c.  
 */


&i2c1 {
	compatible = "nordic,nrf-twim";
	status = "okay";
	sda-pin = <14>;
	scl-pin = <13>;
	clock-frequency = <I2C_BITRATE_STANDARD>;
	/* clock-frequency = <I2C_BITRATE_FAST>;*/
};
```

## src/main.c
```c
/*
 * Copyright (c) Ericsson AB 2020, all rights reserved
 */

#include <ardesco.h>
#include <stdio.h>
#include <string.h>
#include <modem/lte_lc.h>

#include <sht35.h>
#include <modem/modem_info.h>

// #define TEMP_DELTA   0.1
// #define HUM_DELTA    0.1
// #define PRESS_DELTA  0.1

// //HACK:: Adjust the Thingy/Ardesco temp
// #define HACK_ADJVALC  (-1)
// #define HACK_ADJVAL   (-3)


#define BUF_SIZE 2048
char buf[BUF_SIZE];

//========================================================
// Program Entry Point
//========================================================
void main(void)
{
	int rc;
	printk("I2C over Grove example.\"\n");
	
    // Init temp device driver
    rc = sht35_init ("I2C_1");
	printk ("sht35 init returned %d\n", rc);

	// Loop forever.
	while (1)
	{
		float t, h;
		rc = sht35_GetTempHum(&t, &h);

		// printk doesn't support %f
		snprintf (buf, sizeof(buf), "Main loop. Temp: %1.1f Humidity: %1.0f\n", t, h);
		printk ("%s", buf);
		k_sleep(K_MSEC(5000));
	}
}
```

## src/env_sensors.h
```c
/*
 * Copyright (c) 2019 Nordic Semiconductor ASA
 * Copyright (c) Ericsson AB 2020, all rights reserved
 *
 * SPDX-License-Identifier: LicenseRef-BSD-5-Clause-Nordic
 */

#ifndef ENV_SENSORS_H_
#define ENV_SENSORS_H_

#ifdef __cplusplus
extern "C" {
#endif

/**
 * @file env_sensors.h
 * @defgroup env_sensors ENV_SENSORS Environmental sensors interface¨
 * @{
 * @brief Module for interfacing environmental sensors for asset tracker
 *
 * @details Basic basic for interfacing environmental sensors for the
 *          asset tracker application.
 *          Supported sensor types are Temperature, Humidity, Pressure and
 *          air quality sensors.
 *
 */

#include <zephyr/types.h>


/** @brief Environmental sensor types supported */
typedef enum {
	/** Temperature sensor. */
	ENV_SENSOR_TEMPERATURE,
	/** The Humidity sensor. */
	ENV_SENSOR_HUMIDITY,
	/** The Air Pressure sensor. */
	ENV_SENSOR_AIR_PRESSURE,
	/** The Air Quality sensor. */
	ENV_SENSOR_AIR_QUALITY,
} env_sensor_t;

typedef struct {
	/** Sensor type. */
	env_sensor_t type;
	/** Sensor sample value. */
	double value;
} env_sensor_data_t;

/**
 * @brief Get latest sampled temperature data.
 *
 * @param sensor_data Pointer to memory to store latest temperature data.
 *
 * @return 0 if the operation was successful, otherwise a (negative) error code.
 */
int env_sensors_get_temperature(env_sensor_data_t *sensor_data);

/**
 * @brief Get latest sampled humidity data.
 *
 * @param sensor_data Pointer to memory to store latest humidity data.
 *
 * @return 0 if the operation was successful, otherwise a (negative) error code.
 */
int env_sensors_get_humidity(env_sensor_data_t *sensor_data);

/**
 * @brief Get latest sampled pressure data.
 *
 * @param sensor_data Pointer to memory to store latest pressure data.
 *
 * @return 0 if the operation was successful, otherwise a (negative) error code.
 */
int env_sensors_get_pressure(env_sensor_data_t *sensor_data);

/**
 * @brief Get latest sampled air quality data.
 *
 * @param sensor_data Pointer to memory to store latest air quality data.
 *
 * @return 0 if the operation was successful, otherwise a (negative) error code.
 */
int env_sensors_get_air_quality(env_sensor_data_t *sensor_data);


/**
 * @brief Initialize and start the environmental sensors.
 *
 * @return 0 if the operation was successful, otherwise a (negative) error code.
 */
int env_sensors_init_and_start(void);

#ifdef __cplusplus
}
#endif

/**
 * @}
 */

#endif /* ENV_SENSORS_H_ */
```

## src/sht35.h
```c
/*
 * Copyright (c) 2019 Nordic Semiconductor ASA
 * Copyright (c) Ericsson AB 2020, all rights reserved
 *
 * SPDX-License-Identifier: LicenseRef-BSD-5-Clause-Nordic
 */

#ifndef SHT35_H_
#define SHT35_H_

/**@file sht35.h
 *
 * @brief Driver for SHT35.
 * @defgroup sht35 Driver for SHT35
 * @{
 */

#include <zephyr.h>

#include "env_sensors.h"

/**
 * @brief Initialize SHT35.
 *
 * @param[in] dev_name Pointer to the device name.
 *
 * @retval 0 If the operation was successful.
 *           Otherwise, a (negative) error code is returned.
 */
int sht35_init(const char *dev_name);


/**
 * @brief Read the STATUS1 register.
 *
 * @param[out] buf The read value of the STATUS1 register.
 *
 * @retval 0 If the operation was successful.
 *           Otherwise, a (negative) error code is returned.
 */
int sht35_status_read(uint8_t *buf);


/**
 * @brief Reset the device to its default values.
 *
 * @retval 0 If the operation was successful.
 *           Otherwise, a (negative) error code is returned.
 */
int sht35_reset(void);


/**
 * @brief Read temp and humidity values
 *
 * @retval 0 If the operation was successful.
 *           Otherwise, a (negative) error code is returned.
 */
int sht35_GetTempHum(float *Temp, float *Hum);


int ard0022B_grove_ctrl_init_z(bool fDigitalIO);

#endif /* SHT35_H_ */
```
