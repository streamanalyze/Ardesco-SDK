## CMakeLists.txt
```
#
# Copyright (c) Ericsson AB 2020, all rights reserved
#

cmake_minimum_required(VERSION 3.8.2)

# Include Ardesco SDK 
set(AR $ENV{ARDESCO_ROOT})
if(DEFINED AR)
   include($ENV{ARDESCO_ROOT}/ardesco.cmake)
else()
   # Assume we are building from the apps folder in Ardesco tree
   include(${CMAKE_CURRENT_SOURCE_DIR}/../../ardesco.cmake)
endif()

project(using_sensors)

zephyr_compile_definitions(PROJECT_NAME=${PROJECT_NAME})

if(APP_VERSION)
  zephyr_compile_definitions(APP_VERSION=${APP_VERSION})
endif()

# NORDIC SDK APP START
target_sources(app PRIVATE src/main.c)
# NORDIC SDK APP END

# Add lib LED
add_subdirectory(${ARDESCO_LIB_DIR}/sensor_lib ${CMAKE_BINARY_DIR}/lib/sensor_lib)
```

## prj.conf
```kconfig
#
# Copyright (c) Ericsson AB 2020, all rights reserved
#

# This is not strictly needed for this example, but 
# most apps will need heap support.
CONFIG_HEAP_MEM_POOL_SIZE=16384

# Set stack size
CONFIG_MAIN_STACK_SIZE=8192

# Sensors
#CONFIG_ADXL362_TRIGGER_GLOBAL_THREAD=y
#CONFIG_ADXL362_INTERRUPT_MODE=1
#CONFIG_ADXL362_ABS_REF_MODE=1
#CONFIG_ADXL362_ACTIVITY_THRESHOLD=200
#CONFIG_ADXL362_INACTIVITY_THRESHOLD=200

#CONFIG_ADXL372=y
#CONFIG_ADXL372_TRIGGER_GLOBAL_THREAD=y
#CONFIG_ADXL372_SPI=y
#CONFIG_ADXL372_MEASUREMENT_MODE=y

#CONFIG_ADXL372_ACTIVITY_THRESHOLD=200
#CONFIG_ADXL372_INACTIVITY_THRESHOLD=200

#CONFIG_BME680=y
#CONFIG_USE_BME680_BSEC=n
```

## src/main.c
```c
/*
 * Copyright (c) Ericsson AB 2020, all rights reserved
 */

#include <ardesco.h>
#include <stdio.h>
#include "accel_sensor.h"
#include "env_sensor.h"

//========================================================
// Program Entry Point
//========================================================
void main(void)
{
    int rc = 0;
	void *accel_dev = 0;
	void *env_dev = 0;

	printk("\n9160 Sensor Server start.\n");

	k_sleep (K_MSEC (2000));

	// Initialize the environmental library
	env_dev = ardenv_init(&rc);
	if (env_dev == 0)
	{
		while (1)
		{
			printk ("ardenv_init: Error %d\n", rc);
			k_sleep(K_MSEC(2000));
		}
	}

	// Initialize the accel library.
	accel_dev = ardaccel_init(&rc, ACCEL_8G_DEV);
	//accel_dev = ardaccel_init(&rc, ACCEL_200G_DEV);
	if (accel_dev == 0)
	{
		while (1)
		{
			printk ("ardaccel_init: Error %d\n", rc);
			k_sleep(K_MSEC(2000));
		}
	}

    double envvals[3];
    double accelvals[3];
	char sz[128];
	while (1)
	{
		rc = ardenv_read (env_dev, &envvals, sizeof (envvals));
		rc = ardaccel_read (accel_dev, &accelvals, sizeof (accelvals));
		sprintf (sz, "%d  temp %.2f  Hum %.2f  Press %.2f     x %.2f  y %.2f  z %.2f\r\n", 
				 rc, envvals[0], envvals[1], envvals[2], accelvals[0], accelvals[1], accelvals[2]);
		printk ("%s", sz);

		k_sleep(K_MSEC(1000));
	}
}
```
