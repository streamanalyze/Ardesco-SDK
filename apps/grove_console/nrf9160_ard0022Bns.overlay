/ {
	chosen {
		zephyr,console = &uart1;
		zephyr,shell-uart = &uart1;
		zephyr,uart-mcumgr = &uart1;
	};
};

/* Grove Connector */
&uart1 {
	current-speed = <115200>;
	status = "okay";
	tx-pin = <13>;
	rx-pin = <14>;
};

